## CMakeLists.txt
```
cmake_minimum_required(VERSION 3.20.0)

find_package(Zephyr REQUIRED HINTS $ENV{ZEPHYR_BASE})
project(vdrum_receiver)

target_include_directories(app PRIVATE ${CMAKE_CURRENT_SOURCE_DIR}/../common)
target_sources(app PRIVATE src/main.c src/usb_link.c)
```

## prj.conf
```kconfig
# Virtual Drum receiver: ESB PRX -> USB CDC ACM relay (TASK-008).

CONFIG_GPIO=y
CONFIG_BUILD_OUTPUT_UF2=y

# USB device stack ("device_next") with one CDC ACM function.
CONFIG_USB_DEVICE_STACK_NEXT=y
CONFIG_USBD_CDC_ACM_CLASS=y
CONFIG_CDC_ACM_SERIAL_INITIALIZE_AT_BOOT=n
CONFIG_SERIAL=y
CONFIG_UART_INTERRUPT_DRIVEN=y
CONFIG_UART_LINE_CTRL=y
CONFIG_RING_BUFFER=y

# Nothing but protocol frames may reach the host: no console, no logs (printk then goes nowhere).
CONFIG_CONSOLE=n
CONFIG_UART_CONSOLE=n
CONFIG_LOG=n

# ESB receiver. RAW packets need dynamic payloads up to RADIO_MAX_PAYLOAD (105 bytes).
CONFIG_ESB=y
CONFIG_CLOCK_CONTROL=y
CONFIG_ESB_CLOCK_INIT=y
CONFIG_ESB_MAX_PAYLOAD_LENGTH=128
CONFIG_ESB_RX_FIFO_SIZE=16
```

## app.overlay
```dts
/* CDC ACM function on the nRF52840 USB device controller. */
&zephyr_udc0 {
	cdc_acm_uart0: cdc_acm_uart0 {
		compatible = "zephyr,cdc-acm-uart";
		label = "Virtual Drum Receiver";
	};
};
```

## boards/nrf52840dongle_nrf52840.overlay
```dts
/*
 * Receiver on the nRF52840 Dongle (PCA10059): same LED meaning as on the XIAO, where led0 is
 * red and led1 green. On the dongle led0 is the single green LED and led1 the red channel of
 * the RGB LED (zephyr/boards/nordic/nrf52840dongle/nrf52840dongle_nrf52840_common.dtsi).
 */

/ {
	aliases {
		led0 = &led1_red;
		led1 = &led0_green;
	};
};
```

## src/main.c
```c
/*
 * Virtual Drum - USB receiver (XIAO nRF52840).
 *
 * Receives the sticks' ESB packets (PRX, one pipe per stick) and relays each of them to the host
 * over USB CDC as a frame of docs/PROTOCOL.md:
 *   A5 5A | len | rx_time_us u32 | rssi i8 | payload[len] | crc8
 *
 * ESB setup follows nrf/samples/esb/esb_prx (NCS v3.4.1). The radio event handler runs in
 * interrupt context: it only copies payloads into a message queue; a thread builds the frames.
 *
 * Host commands for a stick (pkt_cmd, docs/PROTOCOL.md) go back in the ACK of the stick's
 * next packet: ESB PRX attaches the payload queued for that pipe.
 *
 * LEDs (active low, xiao_ble_common.dtsi): green blinks slowly while idle and flickers while
 * packets arrive; red lights when frames had to be dropped (host not reading).
 */

#include <string.h>

#include <esb.h>
#include <zephyr/drivers/gpio.h>
#include <zephyr/kernel.h>
#include <zephyr/sys/byteorder.h>

#include "protocol.h"
#include "radio_config.h"
#include "usb_link.h"

BUILD_ASSERT(CONFIG_ESB_MAX_PAYLOAD_LENGTH >= VDRUM_ESB_MIN_PAYLOAD_CAPACITY,
	     "CONFIG_ESB_MAX_PAYLOAD_LENGTH too small for RAW packets");

struct rx_packet {
	uint32_t rx_time_us;
	int8_t rssi;
	uint8_t length;
	uint8_t data[RADIO_MAX_PAYLOAD];
};

/* ~0.15 s of both sticks streaming RAW packets (2 x 208 packets/s). */
K_MSGQ_DEFINE(rx_queue, sizeof(struct rx_packet), 64, 4);

static const struct gpio_dt_spec led_green = GPIO_DT_SPEC_GET(DT_ALIAS(led1), gpios);
static const struct gpio_dt_spec led_red = GPIO_DT_SPEC_GET(DT_ALIAS(led0), gpios);

static atomic_t queue_overflows;

static uint32_t now_us(void)
{
	/* Kernel ticks (RTC, 32768 Hz on nRF52): ~30.5 us resolution, enough for phase 0.
	 * Not k_cycle_get_64(): without CONFIG_TIMER_HAS_64BIT_CYCLE_COUNTER it returns 0.
	 */
	return (uint32_t)k_ticks_to_us_floor64(k_uptime_ticks());
}

static void esb_event(struct esb_evt const *event)
{
	if (event->evt_id != ESB_EVENT_RX_RECEIVED) {
		return;
	}

	const uint32_t rx_time = now_us();
	struct esb_payload payload;

	while (esb_read_rx_payload(&payload) == 0) {
		if (payload.length == 0 || payload.length > RADIO_MAX_PAYLOAD) {
			continue;
		}

		struct rx_packet packet = {
			.rx_time_us = rx_time,
			/* ESB reports RSSISAMPLE, a positive magnitude: RSSI = -value dBm. */
			.rssi = (int8_t)-(int)payload.rssi,
			.length = payload.length,
		};

		memcpy(packet.data, payload.data, payload.length);
		if (k_msgq_put(&rx_queue, &packet, K_NO_WAIT) != 0) {
			atomic_inc(&queue_overflows);
		}
	}
}

static int radio_init(void)
{
	uint8_t base_addr_0[4] = VDRUM_ESB_BASE_ADDR_0;
	uint8_t base_addr_1[4] = VDRUM_ESB_BASE_ADDR_1;
	uint8_t prefixes[VDRUM_ESB_PIPE_COUNT] = VDRUM_ESB_PREFIXES;
	struct esb_config config = ESB_DEFAULT_CONFIG;
	int err;

	config.protocol = ESB_PROTOCOL_ESB_DPL;
	config.bitrate = ESB_BITRATE_2MBPS;
	config.mode = ESB_MODE_PRX;
	config.event_handler = esb_event;
	config.selective_auto_ack = true;
	config.use_fast_ramp_up = VDRUM_ESB_FAST_RAMP_UP; /* must match the sticks */
	config.tx_output_power = VDRUM_ESB_TX_POWER_DBM; /* ACKs */

	err = esb_init(&config);
	err = err ? err : esb_set_rf_channel(VDRUM_ESB_RF_CHANNEL);
	err = err ? err : esb_set_base_address_0(base_addr_0);
	err = err ? err : esb_set_base_address_1(base_addr_1);
	err = err ? err : esb_set_prefixes(prefixes, ARRAY_SIZE(prefixes));
	err = err ? err : esb_enable_pipes(BIT(VDRUM_ESB_PIPE_FOR_STICK(0)) | BIT(VDRUM_ESB_PIPE_FOR_STICK(1)));
	err = err ? err : esb_start_rx();
	return err;
}

/*
 * Host command for a stick (system work queue). Only the latest command is kept: older
 * queued ACK payloads are flushed, so a stick never receives a burst of stale commands.
 */
static void on_host_command(const uint8_t *payload, uint8_t len)
{
	if (len != sizeof(struct pkt_cmd) || payload[0] != PKT_CMD || payload[1] >= VDRUM_ESB_PIPE_COUNT) {
		return;
	}

	struct esb_payload ack = {
		.length = len,
		.pipe = VDRUM_ESB_PIPE_FOR_STICK(payload[1]),
	};

	memcpy(ack.data, payload, len);
	/* esb_flush_tx() needs the radio idle (-EBUSY while receiving): a short RX pause. */
	(void)esb_stop_rx();
	(void)esb_flush_tx();
	(void)esb_write_payload(&ack);
	(void)esb_start_rx();
}

/* Builds one USB frame around a radio payload. Returns the frame size. */
static size_t build_frame(const struct rx_packet *packet, uint8_t *frame)
{
	frame[0] = USB_SYNC0;
	frame[1] = USB_SYNC1;
	frame[2] = packet->length;
	sys_put_le32(packet->rx_time_us, &frame[3]);
	frame[7] = (uint8_t)packet->rssi;
	memcpy(&frame[USB_FRAME_HEADER_SIZE], packet->data, packet->length);

	const size_t crc_index = USB_FRAME_HEADER_SIZE + packet->length;

	/* The crc covers everything between the sync bytes and the crc itself. */
	frame[crc_index] = vdrum_crc8_update(CRC8_INIT, &frame[2], (uint32_t)(crc_index - 2));
	return crc_index + 1;
}

static void leds_init(void)
{
	if (gpio_is_ready_dt(&led_green)) {
		(void)gpio_pin_configure_dt(&led_green, GPIO_OUTPUT_INACTIVE);
	}
	if (gpio_is_ready_dt(&led_red)) {
		(void)gpio_pin_configure_dt(&led_red, GPIO_OUTPUT_INACTIVE);
	}
}

int main(void)
{
	static uint8_t frame[USB_FRAME_OVERHEAD + RADIO_MAX_PAYLOAD];
	struct rx_packet packet;
	uint32_t relayed = 0;
	uint32_t last_session = 0;

	leds_init();

	if (radio_init() != 0 || usb_link_init(on_host_command) != 0) {
		/* Fatal setup error: steady red. */
		(void)gpio_pin_set_dt(&led_red, 1);
		return 0;
	}

	while (1) {
		if (k_msgq_get(&rx_queue, &packet, K_MSEC(500)) != 0) {
			/* Idle heartbeat. */
			(void)gpio_pin_toggle_dt(&led_green);
			continue;
		}

		const size_t size = build_frame(&packet, frame);

		(void)usb_link_send(frame, size);

		if ((++relayed & 0x3F) == 0) {
			(void)gpio_pin_toggle_dt(&led_green);
		}
		/* Drops are counted per host session (since the port was last opened). */
		const uint32_t session = usb_link_session();

		if (session != last_session) {
			atomic_clear(&queue_overflows);
			last_session = session;
		}
		(void)gpio_pin_set_dt(&led_red, usb_link_dropped() > 0 || atomic_get(&queue_overflows) > 0);
	}

	return 0;
}
```

## src/usb_link.c
```c
/*
 * USB CDC ACM link, using Zephyr's USB device stack ("device_next").
 * Device setup follows zephyr/samples/subsys/usb/common/sample_usbd_init.c (NCS v3.4.1) and the
 * interrupt-driven TX path follows zephyr/samples/subsys/usb/cdc_acm/src/main.c.
 */

#include "usb_link.h"

#include <errno.h>
#include <string.h>

#include <zephyr/device.h>
#include <zephyr/drivers/uart.h>
#include <zephyr/kernel.h>
#include <zephyr/sys/ring_buffer.h>
#include <zephyr/usb/usbd.h>

#include "protocol.h"

/* ~70 full RAW frames: about 0.15 s of both sticks streaming RAW data. */
#define TX_BUFFER_SIZE 8192

/* Host commands are rare and small (USB_CMD_FRAME_OVERHEAD + a pkt_cmd). */
#define RX_BUFFER_SIZE 256
#define CMD_MAX_PAYLOAD 32

/*
 * The board already defines one CDC ACM function (board_cdc_acm_uart, from
 * boards/common/usb/cdc_acm_serial.dtsi included by xiao_ble_common.dtsi): use it, so that the
 * device exposes a single serial port.
 */
static const struct device *const cdc_dev = DEVICE_DT_GET(DT_NODELABEL(board_cdc_acm_uart));

RING_BUF_DECLARE(tx_ring, TX_BUFFER_SIZE);
RING_BUF_DECLARE(rx_ring, RX_BUFFER_SIZE);
static struct k_spinlock rx_lock;
static usb_link_command_cb command_cb;
static void rx_work_handler(struct k_work *work);
static K_WORK_DEFINE(rx_work, rx_work_handler);
static struct k_spinlock tx_lock;
static uint32_t dropped_blocks;
static atomic_t sessions;
static atomic_t host_open; /* DTR raised: a host application has the port open */

USBD_DEVICE_DEFINE(vdrum_usbd, DEVICE_DT_GET(DT_NODELABEL(zephyr_udc0)), USB_RECEIVER_VID, USB_RECEIVER_PID);

USBD_DESC_LANG_DEFINE(vdrum_lang);
USBD_DESC_MANUFACTURER_DEFINE(vdrum_manufacturer, "Virtual Drum");
USBD_DESC_PRODUCT_DEFINE(vdrum_product, USB_RECEIVER_PRODUCT);
USBD_DESC_CONFIG_DEFINE(vdrum_fs_config_desc, "FS Configuration");

/* Bus powered, 100 mA. */
USBD_CONFIGURATION_DEFINE(vdrum_fs_config, 0, 100, &vdrum_fs_config_desc);

static void uart_isr(const struct device *dev, void *user_data)
{
	ARG_UNUSED(user_data);

	while (uart_irq_update(dev) && uart_irq_is_pending(dev)) {
		if (uart_irq_rx_ready(dev)) {
			/* Host commands: parsed in the system work queue. Bytes that do not fit are
			 * dropped; the parser resynchronises on the next frame.
			 */
			uint8_t scratch[16];
			const int len = uart_fifo_read(dev, scratch, sizeof(scratch));

			if (len > 0) {
				k_spinlock_key_t key = k_spin_lock(&rx_lock);

				(void)ring_buf_put(&rx_ring, scratch, (uint32_t)len);
				k_spin_unlock(&rx_lock, key);
				(void)k_work_submit(&rx_work);
			}
		}

		if (uart_irq_tx_ready(dev)) {
			uint8_t *chunk;
			k_spinlock_key_t key = k_spin_lock(&tx_lock);
			uint32_t len = ring_buf_get_claim(&tx_ring, &chunk, 64);

			if (len == 0) {
				uart_irq_tx_disable(dev);
				k_spin_unlock(&tx_lock, key);
				continue;
			}

			int sent = uart_fifo_fill(dev, chunk, (int)len);

			(void)ring_buf_get_finish(&tx_ring, sent > 0 ? (uint32_t)sent : 0);
			k_spin_unlock(&tx_lock, key);
		}
	}
}

/*
 * Host -> receiver command frames (docs/PROTOCOL.md):
 *   A5 5A | len | payload[len] | crc8 (over len and payload)
 * Any error (bad length, bad crc) drops one byte and resynchronises on the next sync bytes.
 */
static void rx_work_handler(struct k_work *work)
{
	static uint8_t frame[USB_CMD_FRAME_OVERHEAD + CMD_MAX_PAYLOAD];
	static uint32_t fill;

	ARG_UNUSED(work);

	while (true) {
		k_spinlock_key_t key = k_spin_lock(&rx_lock);

		fill += ring_buf_get(&rx_ring, &frame[fill], sizeof(frame) - fill);
		const bool more = !ring_buf_is_empty(&rx_ring);

		k_spin_unlock(&rx_lock, key);

		/* Drop bytes until the buffer starts with the sync sequence. */
		uint32_t start = 0;

		while (start < fill && !(frame[start] == USB_SYNC0 &&
					 (start + 1 == fill || frame[start + 1] == USB_SYNC1))) {
			start++;
		}
		if (start > 0) {
			memmove(frame, &frame[start], fill - start);
			fill -= start;
		}
		if (fill < 3) {
			if (!more) {
				return;
			}
			continue;
		}

		const uint8_t len = frame[2];
		const uint32_t size = USB_CMD_FRAME_OVERHEAD + len;

		if (len == 0 || len > CMD_MAX_PAYLOAD) {
			memmove(frame, &frame[1], --fill);
			continue;
		}
		if (fill < size) {
			if (!more) {
				return;
			}
			continue;
		}
		if (frame[size - 1] == vdrum_crc8_update(CRC8_INIT, &frame[2], len + 1)) {
			if (command_cb != NULL) {
				command_cb(&frame[3], len);
			}
			memmove(frame, &frame[size], fill - size);
			fill -= size;
		} else {
			memmove(frame, &frame[1], --fill);
		}
	}
}

static void usbd_message(struct usbd_context *const ctx, const struct usbd_msg *msg)
{
	/* The nRF52840 detects VBUS: enable the device when a host is plugged in. */
	if (usbd_can_detect_vbus(ctx)) {
		if (msg->type == USBD_MSG_VBUS_READY) {
			(void)usbd_enable(ctx);
		} else if (msg->type == USBD_MSG_VBUS_REMOVED) {
			(void)usbd_disable(ctx);
		}
	}

	/*
	 * A host application opened the port (DTR raised): drop what piled up while nobody was
	 * reading, and restart the drop counter so that it reflects this session only. While the
	 * port is closed nothing is queued (usb_link_send), so that a new session does not start
	 * with old packets; the CDC ACM driver may still hold the few bytes it had already taken
	 * (measured: up to ~2 min old at the next open), which host tools skip (tools/logger.py).
	 */
	if (msg->type == USBD_MSG_CDC_ACM_CONTROL_LINE_STATE) {
		uint32_t dtr = 0;

		(void)uart_line_ctrl_get(msg->dev, UART_LINE_CTRL_DTR, &dtr);
		k_spinlock_key_t key = k_spin_lock(&tx_lock);

		ring_buf_reset(&tx_ring);
		if (dtr) {
			dropped_blocks = 0;
		}
		atomic_set(&host_open, dtr ? 1 : 0);
		k_spin_unlock(&tx_lock, key);
		if (dtr) {
			atomic_inc(&sessions);
		}
	}
}

int usb_link_init(usb_link_command_cb on_command)
{
	int err;

	if (!device_is_ready(cdc_dev)) {
		return -ENODEV;
	}
	command_cb = on_command;

	err = usbd_add_descriptor(&vdrum_usbd, &vdrum_lang);
	err = err ? err : usbd_add_descriptor(&vdrum_usbd, &vdrum_manufacturer);
	err = err ? err : usbd_add_descriptor(&vdrum_usbd, &vdrum_product);
	err = err ? err : usbd_add_configuration(&vdrum_usbd, USBD_SPEED_FS, &vdrum_fs_config);
	err = err ? err : usbd_register_all_classes(&vdrum_usbd, USBD_SPEED_FS, 1, NULL);
	if (err) {
		return err;
	}

	/* Composite-style class codes so that hosts read the CDC interface descriptors (IAD). */
	usbd_device_set_code_triple(&vdrum_usbd, USBD_SPEED_FS, USB_BCC_MISCELLANEOUS, 0x02, 0x01);

	err = usbd_msg_register_cb(&vdrum_usbd, usbd_message);
	err = err ? err : usbd_init(&vdrum_usbd);
	if (err) {
		return err;
	}

	uart_irq_callback_set(cdc_dev, uart_isr);
	uart_irq_rx_enable(cdc_dev);

	if (!usbd_can_detect_vbus(&vdrum_usbd)) {
		return usbd_enable(&vdrum_usbd);
	}
	return 0;
}

int usb_link_send(const uint8_t *data, size_t len)
{
	if (!atomic_get(&host_open)) {
		return -ENOTCONN; /* nobody reading: not a drop */
	}

	k_spinlock_key_t key = k_spin_lock(&tx_lock);

	if (ring_buf_space_get(&tx_ring) < len) {
		dropped_blocks++;
		k_spin_unlock(&tx_lock, key);
		return -ENOSPC;
	}

	(void)ring_buf_put(&tx_ring, data, (uint32_t)len);
	k_spin_unlock(&tx_lock, key);

	uart_irq_tx_enable(cdc_dev);
	return 0;
}

uint32_t usb_link_dropped(void)
{
	return dropped_blocks;
}

uint32_t usb_link_session(void)
{
	return (uint32_t)atomic_get(&sessions);
}
```

## src/usb_link.h
```c
/*
 * USB CDC ACM link to the host: device descriptors and a buffered, interrupt-driven
 * transmit path. Frames are written whole or dropped (never split by a full buffer).
 * In the other direction, host command frames are parsed and handed to a callback.
 */
#ifndef VDRUM_USB_LINK_H
#define VDRUM_USB_LINK_H

#include <stddef.h>
#include <stdint.h>

/* Called from the system work queue with the payload of each valid host command frame. */
typedef void (*usb_link_command_cb)(const uint8_t *payload, uint8_t len);

/* Registers the USB device and enables it (or waits for VBUS). Returns 0 or a negative errno. */
int usb_link_init(usb_link_command_cb on_command);

/*
 * Queues bytes for the host. Thread context only. Returns 0, -ENOTCONN if no host application
 * has the port open (nothing queued), or -ENOSPC if the whole block does not fit (it is then
 * dropped entirely, so the host never sees half a frame).
 */
int usb_link_send(const uint8_t *data, size_t len);

/* Blocks dropped because the host was not reading fast enough. */
uint32_t usb_link_dropped(void);

/* Incremented each time a host application opens the port (DTR raised). */
uint32_t usb_link_session(void);

#endif /* VDRUM_USB_LINK_H */
```
