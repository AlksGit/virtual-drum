## firmware/stick/build0/Kconfig/boards/Kconfig.sysbuild
```kconfig
# Load Sysbuild board Kconfig descriptions.
osource "C:/ncs/v3.4.1/zephyr/boards/seeed/xiao_ble/Kconfig.sysbuild"
```

## firmware/stick/build1/Kconfig/boards/Kconfig.defconfig
```kconfig
# Load Zephyr board defconfig descriptions.
osource "C:/ncs/v3.4.1/zephyr/boards/seeed/xiao_ble/Kconfig.defconfig"
```

## firmware/stick/build1/Kconfig/boards/Kconfig.xiao_ble
```kconfig
# Load board Kconfig descriptions.
osource "C:/ncs/v3.4.1/zephyr/boards/seeed/xiao_ble/Kconfig.xiao_ble"
```
