## CMakeLists.txt
```
cmake_minimum_required(VERSION 3.20.0)

find_package(Zephyr REQUIRED HINTS $ENV{ZEPHYR_BASE})
project(vdrum_stick)

target_include_directories(app PRIVATE ${CMAKE_CURRENT_SOURCE_DIR}/../common)
target_sources(app PRIVATE src/main.c src/imu.c src/radio.c src/hit.c src/fusion.c)
```

## Kconfig
```
# Virtual Drum stick options.

config VDRUM_STICK_ID
	int "Stick id (0 = left, 1 = right)"
	range 0 1
	default 0
	help
	  Written in every packet header and selects the ESB pipe. Build the right stick with
	  -DCONFIG_VDRUM_STICK_ID=1.

config VDRUM_STREAM_RAW
	bool "Stream raw IMU samples (RAW packets)"
	default y
	help
	  Phase 0 recorder: every IMU sample goes out in RAW packets, about 30 % of the air time with
	  two sticks. Hits are sent either way. Build with -DCONFIG_VDRUM_STREAM_RAW=n to play: only
	  HIT and STATUS packets go out, so a hit never waits behind RAW packets.

config VDRUM_SLEEP_AFTER_S
	int "Power off after this long at rest, in seconds (0 = never)"
	range 0 3600
	default 0 if VDRUM_STREAM_RAW
	default 10
	help
	  The stick has no power switch: after this long without moving (the rest test of the gyro
	  bias calibration), it enters System OFF and wakes on a sharp knock. Off in the recorder build,
	  whose rest recordings last 10 minutes.

config VDRUM_SLEEP_WITHOUT_HIT_S
	int "Power off after this long without a hit, in seconds (0 = never)"
	range 0 3600
	default 0 if VDRUM_STREAM_RAW
	default 300
	help
	  Safety net for the battery: power off even if the rest test never sees the stick at rest
	  (on 2026-11-09 a wrong FIFO order made the left stick look always moving, and it never
	  slept). Woken by a sharp knock, like after a rest.

# ST's LSM6DS3TR-C driver from hal_st (hidden symbols, selected here).
config VDRUM_STICK_IMU_DRIVER
	bool
	default y
	select HAS_STMEMSC
	select USE_STDC_LSM6DS3TR_C

source "Kconfig.zephyr"
```

## prj.conf
```kconfig
# Virtual Drum stick (XIAO nRF52840 Sense).

CONFIG_GPIO=y
CONFIG_BUILD_OUTPUT_UF2=y

# IMU on i2c0; its supply is the "lsm6ds3tr-c-en" fixed regulator, enabled at boot.
CONFIG_I2C=y
CONFIG_REGULATOR=y

# The sensor is driven directly through ST's driver: keep Zephyr's sensor drivers out.
CONFIG_SENSOR=n

# ESB transmitter. RAW packets need dynamic payloads up to RADIO_MAX_PAYLOAD (105 bytes).
CONFIG_ESB=y
CONFIG_CLOCK_CONTROL=y
CONFIG_ESB_CLOCK_INIT=y
CONFIG_ESB_MAX_PAYLOAD_LENGTH=128

# No USB on the stick: the xiao_ble board enables a USB CDC console by default
# (boards/common/usb/Kconfig.cdc_acm_serial.defconfig). The stick logs nothing and reports over
# the radio, so its USB interrupts and threads (while charging) are not wanted. USB-C still
# charges the battery, and the UF2 bootloader (double-tap reset) is unaffected.
CONFIG_USB_DEVICE_STACK_NEXT=n
CONFIG_CONSOLE=n
CONFIG_UART_CONSOLE=n
CONFIG_SERIAL=n

# Restart into the UF2 bootloader on a radio command (sys_reboot).
CONFIG_REBOOT=y

# System OFF after a rest (CONFIG_VDRUM_SLEEP_AFTER_S), woken by the IMU on INT1.
CONFIG_POWEROFF=y

# Gyro bias kept through System OFF in a retained RAM region (boards/*.overlay), CRC checked.
CONFIG_RETAINED_MEM=y
CONFIG_CRC=y

# Hit detection and orientation fusion run in float on the IMU thread: use the Cortex-M4F FPU
# (nRF52840 Product Specification, "ARM Cortex-M4 processor with floating-point unit").
# The main thread also reads float state (gyro bias): save FPU contexts on switches.
CONFIG_FPU=y
CONFIG_FPU_SHARING=y
```

## boards/xiao_ble_nrf52840_sense.overlay
```dts
/*
 * RAM kept through System OFF for the fusion state (gyro bias), as in the Zephyr sample
 * samples/boards/nordic/system_off (boards/nrf52840dk_nrf52840.overlay, NCS v3.4.1). Zephyr's
 * nRF poweroff turns retention off for all RAM except the zephyr,retained-ram regions
 * (soc/nordic/common/poweroff.c). The region sits away from the top of RAM, where the UF2
 * bootloader that runs first after the wake-up reset keeps its stack; its content is checked
 * by a CRC anyway (fusion.c).
 */
/ {
	sram@20038000 {
		compatible = "zephyr,memory-region", "mmio-sram";
		reg = <0x20038000 DT_SIZE_K(4)>;
		zephyr,memory-region = "RetainedMem";
		status = "okay";

		fusion_retained: retainedmem {
			compatible = "zephyr,retained-ram";
			status = "okay";
		};
	};
};

&sram0 {
	/* Shrunk below the retained region (the stick firmware uses about 12 KB of RAM). */
	reg = <0x20000000 DT_SIZE_K(224)>;
};
```

## src/main.c
```c
/*
 * Virtual Drum - drumstick (XIAO nRF52840 Sense).
 *
 * Reads the IMU at 1.66 kHz (accelerometer +-16 g, gyroscope +-2000 dps), tracks the stick
 * orientation, detects hits on board and sends them as HIT packets over ESB, with ORIENT at
 * ~100 Hz and a STATUS packet every second. With
 * CONFIG_VDRUM_STREAM_RAW (phase 0 recorder), every sample also goes out in RAW packets of 8.
 * The stick id (0 = left, 1 = right) is CONFIG_VDRUM_STICK_ID.
 *
 * After CONFIG_VDRUM_SLEEP_AFTER_S at rest, the stick powers off (System OFF, radio and LEDs
 * off) with the IMU watching for motion; picking it up wakes it through a reset: a normal boot.
 * The rest test is its own, looser than the per-sample one the fusion had in firmware 6 (6 dps
 * and 0.05 g on every sample): lying on a table, the left stick broke that one after 63 s at
 * most (gyro noise) and the right one came
 * within 0.001 g of it (accelerometer reading 1.03 g), session_20261104_143641. Here motion is
 * MOVING_RUN consecutive samples beyond 20 dps from the bias or 0.15 g from 1 g: that session
 * then rests 363 s (one knock) and 600 s, and play sessions never rest more than 21 s.
 * Whatever the rest test says, the stick also powers off after CONFIG_VDRUM_SLEEP_WITHOUT_HIT_S
 * without a hit. The gyro bias is kept through System OFF (fusion_store()), so a woken stick
 * does not start with a zero bias.
 *
 * LEDs (active low, zephyr/boards/seeed/xiao_ble/xiao_ble_common.dtsi): blue blinks while
 * packets go out (about twice per second), red stays on if the IMU or the radio could not be
 * started, or while samples or packets are being lost.
 */

#include <stdbool.h>

#include <zephyr/drivers/gpio.h>
#include <zephyr/kernel.h>
#include <zephyr/sys/poweroff.h>
#include <zephyr/sys/reboot.h>

#include "fusion.h"
#include "hit.h"
#include "imu.h"
#include "radio.h"

static const struct gpio_dt_spec led_blue = GPIO_DT_SPEC_GET(DT_ALIAS(led2), gpios);
static const struct gpio_dt_spec led_red = GPIO_DT_SPEC_GET(DT_ALIAS(led0), gpios);

/* One ORIENT packet every 16 samples: 104 Hz at 1.66 kHz. */
#define ORIENT_EVERY_SAMPLES 16u

#define SLEEP_AFTER_SAMPLES ((uint32_t)CONFIG_VDRUM_SLEEP_AFTER_S * IMU_ODR_HZ)

/* Rest test (see the top). LSM6DS3TR-C: 70 mdps/LSB at +-2000 dps, 0.488 mg/LSB at +-16 g
 * (docs/HARDWARE.md).
 */
#define MOVING_GYRO_COUNTS 286   /* 20 dps */
#define ONE_G_COUNTS 2049
#define MOVING_ACCEL_COUNTS 307  /* 0.15 g */
#define MOVING_RUN 3u

/* Samples since the stick last moved: IMU thread writes, main thread reads (one word). */
static volatile uint32_t rest_samples;

/* Uptime of the last hit, or of the boot (ms): IMU thread writes, main thread reads. */
static volatile uint32_t last_hit_ms;

static void on_hit(uint32_t t_us, uint8_t velocity, uint8_t flags)
{
	int16_t quat[4];

	last_hit_ms = k_uptime_get_32();
	fusion_get_quat_q14(quat);
	radio_send_hit(t_us, velocity, quat, flags);
}

static bool sample_moves(const struct imu_sample *s, const int16_t bias[3])
{
	const int32_t g[3] = { s->gx - bias[0], s->gy - bias[1], s->gz - bias[2] };
	/* Up to 3 x 2^30 at full scale: unsigned. */
	const uint32_t norm_sq = (uint32_t)(s->ax * s->ax) + (uint32_t)(s->ay * s->ay) + (uint32_t)(s->az * s->az);
	const uint32_t low = ONE_G_COUNTS - MOVING_ACCEL_COUNTS, high = ONE_G_COUNTS + MOVING_ACCEL_COUNTS;

	for (int i = 0; i < 3; i++) {
		if (g[i] > MOVING_GYRO_COUNTS || g[i] < -MOVING_GYRO_COUNTS) {
			return true;
		}
	}
	return norm_sq < low * low || norm_sq > high * high;
}

static void track_rest(const struct imu_sample *samples, uint32_t count)
{
	static uint32_t moving_run;
	int16_t bias[3];

	fusion_get_bias(bias);
	for (uint32_t i = 0; i < count; i++) {
		moving_run = sample_moves(&samples[i], bias) ? moving_run + 1 : 0;
		rest_samples = moving_run >= MOVING_RUN ? 0 : rest_samples + 1;
	}
}

static void on_samples(const struct imu_sample *samples, uint32_t count, uint32_t first_time_us)
{
	static uint32_t orient_countdown = ORIENT_EVERY_SAMPLES;

	for (uint32_t i = 0; i < count; i++) {
		const uint32_t t_us = first_time_us + i * IMU_SAMPLE_PERIOD_US;

		fusion_process(&samples[i]);
		hit_process(&samples[i], 1, t_us);
		if (--orient_countdown == 0) {
			int16_t quat[4];

			orient_countdown = ORIENT_EVERY_SAMPLES;
			fusion_get_quat_q14(quat);
			radio_send_orient(t_us, quat);
		}
	}
	track_rest(samples, count);
	if (IS_ENABLED(CONFIG_VDRUM_STREAM_RAW)) {
		radio_send_samples(samples, count, first_time_us);
	}
}

static void power_off(void)
{
	(void)gpio_pin_set_dt(&led_blue, 0);
	(void)gpio_pin_set_dt(&led_red, 0); /* outputs keep their level through System OFF */
	if (imu_prepare_sleep() != 0) {
		/* No wake-up source, and streaming has stopped: restart instead. */
		sys_reboot(SYS_REBOOT_COLD);
	}
	fusion_store(); /* the IMU thread has ended: the bias no longer changes */
	sys_poweroff();
}

int main(void)
{
	(void)gpio_pin_configure_dt(&led_blue, GPIO_OUTPUT_INACTIVE);
	(void)gpio_pin_configure_dt(&led_red, GPIO_OUTPUT_INACTIVE);

	fusion_init();
	hit_init(on_hit);
	if (radio_start(CONFIG_VDRUM_STICK_ID) != 0 || imu_start(on_samples) != 0) {
		(void)gpio_pin_set_dt(&led_red, 1);
		return 0;
	}

	struct imu_stats imu = { 0 };
	struct radio_stats radio = { 0 };
	uint32_t last_sent = 0, last_lost = 0;

	for (uint32_t tick = 0;; tick++) {
		k_msleep(250);

		if (CONFIG_VDRUM_SLEEP_AFTER_S > 0 && rest_samples > SLEEP_AFTER_SAMPLES) {
			power_off();
		}
		if (CONFIG_VDRUM_SLEEP_WITHOUT_HIT_S > 0 &&
		    k_uptime_get_32() - last_hit_ms > (uint32_t)CONFIG_VDRUM_SLEEP_WITHOUT_HIT_S * 1000u) {
			power_off();
		}

		if (tick % 4 == 0) {
			/* Battery measurement needs the divider ratio (docs/HARDWARE.md): 0 = unknown. */
			int16_t bias[3];

			imu_get_stats(&imu);
			fusion_get_bias(bias);
			radio_send_status(0, imu.fifo_overruns, bias);
		}

		imu_get_stats(&imu);
		radio_get_stats(&radio);

		if (radio.packets_sent != last_sent) {
			(void)gpio_pin_toggle_dt(&led_blue);
		}
		last_sent = radio.packets_sent;

		const uint32_t lost = imu.fifo_overruns + imu.bus_errors + radio.packets_failed + radio.queue_full;

		(void)gpio_pin_set_dt(&led_red, lost != last_lost);
		last_lost = lost;
	}

	return 0;
}
```

## src/fusion.c
```c
/*
 * Mahony fusion, ported from tools/detection/fusion.py (Mahony.process); constants are the
 * FusionConfig defaults, see that file for the reasoning.
 *
 * - Gyro bias averaged while the stick is still, so each pause recalibrates it. Still = the
 *   means of blocks of STILL_BLOCK samples stay close to their mean over STILL_BLOCKS blocks,
 *   whatever the current bias (a wrong bias locked the left stick at 3 deg/s of drift on
 *   2026-11-06 with a test against the bias).
 * - Accelerometer correction only when its norm is close to 1 g and the stick turns slowly:
 *   strokes read 10+ g, and at the butt the centripetal acceleration points along the stick,
 *   where it passes for a tilt (hits read +35 deg of elevation on 2026-11-06).
 * - The bias is kept through System OFF (retained RAM, boards/xiao_ble_nrf52840_sense.overlay):
 *   a stick woken by a knock starts with it instead of zero, and refines it at the next rest.
 *   Without it, the first calibration took one window, which a slow turn can fool (the right
 *   stick started 2.6 deg/s off on 2026-11-09 and took ~8 s to settle).
 */

#include "fusion.h"

#include <math.h>
#include <stdbool.h>
#include <stddef.h>
#include <string.h>

#include <zephyr/device.h>
#include <zephyr/drivers/retained_mem.h>
#include <zephyr/sys/crc.h>

#include "imu.h"

/* LSM6DS3TR-C (docs/HARDWARE.md): 70 mdps/LSB at +-2000 dps, 0.488 mg/LSB at +-16 g. */
#define GYRO_DPS_PER_LSB 0.070f
#define ACCEL_G_PER_LSB 0.488e-3f
#define DEG_TO_RAD 0.017453293f

#define DT (1.0f / (float)IMU_ODR_HZ)
#define KP 1.0f
#define KP_START 10.0f
#define START_SAMPLES (IMU_ODR_HZ * 1u)
#define ACCEL_GATE_G 0.15f
#define ACCEL_GATE_DPS 30.0f
#define STILL_BLOCK 16u
#define STILL_BLOCKS ((IMU_ODR_HZ / 2u + STILL_BLOCK / 2u) / STILL_BLOCK) /* 0.5 s */
#define STILL_GYRO_DPS 1.5f
#define STILL_ACCEL_G 0.02f
#define STILL_NORM_G 0.1f
#define BIAS_ALPHA 0.005f /* per still block once calibrated */

#define SAVED_MAGIC 0x31424456u /* "VDB1" */

/* Fusion state kept through System OFF. */
struct saved_state {
	uint32_t magic;
	float bias_dps[3];
	uint32_t crc; /* crc32_ieee of the fields above */
};

static const struct device *const retained = DEVICE_DT_GET(DT_NODELABEL(fusion_retained));

static float q[4] = { 1.0f, 0.0f, 0.0f, 0.0f };
static float bias_dps[3];
static bool bias_valid;
static uint32_t samples;

/* Rest detection: sums of the current block, then the last STILL_BLOCKS block means
 * (gx, gy, gz in dps, ax, ay, az in g) in a ring.
 */
static float block_sum[6];
static uint32_t block_count;
static float window[STILL_BLOCKS][6];
static uint32_t window_next;
static uint32_t window_fill;

static void track_rest(const float g[3], const float a[3])
{
	for (int i = 0; i < 3; i++) {
		block_sum[i] += g[i];
		block_sum[3 + i] += a[i];
	}
	if (++block_count < STILL_BLOCK) {
		return;
	}
	for (int i = 0; i < 6; i++) {
		window[window_next][i] = block_sum[i] / (float)STILL_BLOCK;
		block_sum[i] = 0.0f;
	}
	block_count = 0;
	window_next = (window_next + 1u) % STILL_BLOCKS;
	if (window_fill < STILL_BLOCKS) {
		window_fill++;
		return;
	}

	float mean[6] = { 0 };

	for (uint32_t b = 0; b < STILL_BLOCKS; b++) {
		for (int i = 0; i < 6; i++) {
			mean[i] += window[b][i] / (float)STILL_BLOCKS;
		}
	}
	for (uint32_t b = 0; b < STILL_BLOCKS; b++) {
		for (int i = 0; i < 6; i++) {
			const float tol = i < 3 ? STILL_GYRO_DPS : STILL_ACCEL_G;

			if (fabsf(window[b][i] - mean[i]) >= tol) {
				return;
			}
		}
	}
	if (fabsf(sqrtf(mean[3] * mean[3] + mean[4] * mean[4] + mean[5] * mean[5]) - 1.0f) >= STILL_NORM_G) {
		return;
	}
	for (int i = 0; i < 3; i++) {
		bias_dps[i] = bias_valid ? bias_dps[i] + BIAS_ALPHA * (mean[i] - bias_dps[i]) : mean[i];
	}
	bias_valid = true;
}

void fusion_process(const struct imu_sample *s)
{
	const float g[3] = { s->gx * GYRO_DPS_PER_LSB, s->gy * GYRO_DPS_PER_LSB, s->gz * GYRO_DPS_PER_LSB };
	const float a[3] = { s->ax * ACCEL_G_PER_LSB, s->ay * ACCEL_G_PER_LSB, s->az * ACCEL_G_PER_LSB };
	const float a_norm = sqrtf(a[0] * a[0] + a[1] * a[1] + a[2] * a[2]);

	samples++;
	track_rest(g, a);

	float w[3];

	for (int i = 0; i < 3; i++) {
		w[i] = (g[i] - bias_dps[i]) * DEG_TO_RAD;
	}

	const float rate_sq = w[0] * w[0] + w[1] * w[1] + w[2] * w[2];
	const float gate_rad = ACCEL_GATE_DPS * DEG_TO_RAD;

	if (fabsf(a_norm - 1.0f) < ACCEL_GATE_G && rate_sq < gate_rad * gate_rad) {
		/* World up seen in the stick frame, crossed with the measured one. */
		const float vx = 2.0f * (q[1] * q[3] - q[0] * q[2]);
		const float vy = 2.0f * (q[0] * q[1] + q[2] * q[3]);
		const float vz = q[0] * q[0] - q[1] * q[1] - q[2] * q[2] + q[3] * q[3];
		const float ax = a[0] / a_norm, ay = a[1] / a_norm, az = a[2] / a_norm;
		const float kp = samples < START_SAMPLES ? KP_START : KP;

		w[0] += kp * (ay * vz - az * vy);
		w[1] += kp * (az * vx - ax * vz);
		w[2] += kp * (ax * vy - ay * vx);
	}

	/* q += 0.5 * q * (0, w) * dt */
	const float qw = q[0], qx = q[1], qy = q[2], qz = q[3];
	const float h = 0.5f * DT;

	q[0] = qw + h * (-qx * w[0] - qy * w[1] - qz * w[2]);
	q[1] = qx + h * (qw * w[0] + qy * w[2] - qz * w[1]);
	q[2] = qy + h * (qw * w[1] - qx * w[2] + qz * w[0]);
	q[3] = qz + h * (qw * w[2] + qx * w[1] - qy * w[0]);

	const float n = sqrtf(q[0] * q[0] + q[1] * q[1] + q[2] * q[2] + q[3] * q[3]);

	for (int i = 0; i < 4; i++) {
		q[i] /= n;
	}
}

void fusion_init(void)
{
	struct saved_state saved;

	if (!device_is_ready(retained) ||
	    retained_mem_read(retained, 0, (uint8_t *)&saved, sizeof(saved)) != 0) {
		return;
	}
	if (saved.magic != SAVED_MAGIC ||
	    saved.crc != crc32_ieee((const uint8_t *)&saved, offsetof(struct saved_state, crc))) {
		return; /* power-up, or overwritten (bootloader): calibrate from scratch */
	}
	for (int i = 0; i < 3; i++) {
		if (!isfinite(saved.bias_dps[i])) {
			return;
		}
	}
	memcpy(bias_dps, saved.bias_dps, sizeof(bias_dps));
	bias_valid = true;
}

void fusion_store(void)
{
	struct saved_state saved = { .magic = SAVED_MAGIC };

	if (!bias_valid || !device_is_ready(retained)) {
		return;
	}
	memcpy(saved.bias_dps, bias_dps, sizeof(saved.bias_dps));
	saved.crc = crc32_ieee((const uint8_t *)&saved, offsetof(struct saved_state, crc));
	(void)retained_mem_write(retained, 0, (const uint8_t *)&saved, sizeof(saved));
}

static int16_t to_q14(float v)
{
	const float scaled = v * 16384.0f;

	return scaled >= 32767.0f ? 32767 : (scaled <= -32768.0f ? -32768 : (int16_t)lroundf(scaled));
}

void fusion_get_quat_q14(int16_t quat[4])
{
	for (int i = 0; i < 4; i++) {
		quat[i] = to_q14(q[i]);
	}
}

void fusion_get_bias(int16_t bias[3])
{
	for (int i = 0; i < 3; i++) {
		bias[i] = (int16_t)lroundf(bias_dps[i] / GYRO_DPS_PER_LSB);
	}
}
```

## src/fusion.h
```c
/*
 * Orientation fusion (Mahony, proportional only) with gyro bias calibration at rest: port of
 * tools/detection/fusion.py. The quaternion takes the stick frame to the world frame
 * (docs/PROTOCOL.md).
 */
#ifndef VDRUM_FUSION_H
#define VDRUM_FUSION_H

#include <stdint.h>

#include "protocol.h"

/* Before the IMU starts: takes the gyro bias kept through System OFF, if any. */
void fusion_init(void);

/* Keeps the gyro bias through System OFF. Call with the IMU thread stopped, before powering off. */
void fusion_store(void);

/* IMU thread context: one call per sample, at the IMU rate. */
void fusion_process(const struct imu_sample *sample);

/* Current orientation, w, x, y, z in Q14 (IMU thread context). */
void fusion_get_quat_q14(int16_t quat[4]);

/* Gyro bias in raw gyro counts (any thread: a torn read only mixes two close estimates). */
void fusion_get_bias(int16_t bias[3]);

#endif /* VDRUM_FUSION_H */
```

## src/hit.c
```c
/*
 * Hit detector, ported from tools/detection/detector.py (HitDetector, stroke_rate).
 *
 * The stroke rate is the gyro rate in the stick's y-z plane, signed by y: a downstroke rotates
 * the stick around +y (stick frame: x to the tip, z up, y left, measured 2026-11-03 in
 * docs/HARDWARE.md), so it reads positive. A hit fires when, after a downstroke faster than
 * ON_DPS, the rate falls below RELEASE_FRACTION x its peak: the stick is being braked.
 *
 * Velocity is the peak rate scaled to 1..127. The Python VelocityModel (peak predicted from the
 * rise acceleration when the gyro saturates) needs a per-player calibration: not ported yet; a
 * saturated stroke is sent at 127 with HIT_FLAG_GYRO_SAT.
 */

#include "hit.h"

#include "imu.h"

#include <math.h>
#include <stdbool.h>
#include <stddef.h>

/* LSM6DS3TR-C at +-2000 dps: 70 mdps/LSB (docs/HARDWARE.md, lsm6ds3tr_c_from_fs2000dps_to_mdps). */
#define GYRO_DPS_PER_LSB 0.070f

#define ON_DPS 260.0f           /* detector.py DetectorConfig.on_dps */
#define RELEASE_FRACTION 0.35f  /* detector.py DetectorConfig.release_fraction */
/* detector.py uses 40 ms. On real air strokes (session_20261103_153541) 40 ms leaves detections
 * 41-70 ms after the previous one (15 of 141): rebounds or fast roll strokes, which that session
 * cannot tell apart (no ground truth). Hits on a cushion (2026-11-04, 70 ms) still gave weak
 * doubles ~80 ms after a strong hit: rebounds. 100 ms still allows 10 strokes/s per hand. */
#define REFRACTORY_US 100000u
/* Rate mapped to velocity 127. Air strokes peaked at 1360 dps (docs/MEASUREMENTS.md,
 * 2026-11-03), but hits on a cushion (2026-11-04) peaked at 260-660 dps: at 1500 dps they came
 * out at velocity 22-56, nearly inaudible through the host's gain curve (v^1.6). */
#define MAX_SPEED_DPS 800.0f

static hit_cb callback;
static bool in_stroke;
static bool stroke_saturated;
static float peak_dps;
static uint32_t refractory_until_us;
static bool refractory;

void hit_init(hit_cb on_hit)
{
	callback = on_hit;
}

static bool saturated(int16_t value)
{
	return value == INT16_MAX || value == INT16_MIN;
}

static uint8_t velocity_from_peak(float peak, bool sat)
{
	if (sat) {
		return 127;
	}
	const float v = peak / MAX_SPEED_DPS * 127.0f;

	return v >= 127.0f ? 127 : (v < 1.0f ? 1 : (uint8_t)v);
}

static void process_one(const struct imu_sample *s, uint32_t t_us)
{
	const float gy = (float)s->gy * GYRO_DPS_PER_LSB;
	const float gz = (float)s->gz * GYRO_DPS_PER_LSB;
	const float magnitude = sqrtf(gy * gy + gz * gz);
	const float rate = gy >= 0.0f ? magnitude : -magnitude;
	const bool sat = saturated(s->gy) || saturated(s->gz);

	if (refractory) {
		if ((int32_t)(t_us - refractory_until_us) < 0) {
			return;
		}
		refractory = false;
	}

	if (!in_stroke) {
		if (rate > ON_DPS) {
			in_stroke = true;
			peak_dps = rate;
			stroke_saturated = sat;
		}
		return;
	}

	if (rate >= peak_dps) {
		peak_dps = rate;
	}
	stroke_saturated = stroke_saturated || sat;

	if (rate < RELEASE_FRACTION * peak_dps) {
		in_stroke = false;
		refractory = true;
		refractory_until_us = t_us + REFRACTORY_US;
		if (callback != NULL) {
			callback(t_us, velocity_from_peak(peak_dps, stroke_saturated),
				 stroke_saturated ? HIT_FLAG_GYRO_SAT : 0);
		}
	}
}

void hit_process(const struct imu_sample *samples, uint32_t count, uint32_t first_time_us)
{
	for (uint32_t i = 0; i < count; i++) {
		process_one(&samples[i], first_time_us + i * IMU_SAMPLE_PERIOD_US);
	}
}
```

## src/hit.h
```c
/*
 * On-board hit detection: port of tools/detection/detector.py (HitDetector), one sample at a
 * time, a few state variables, no buffers.
 */
#ifndef VDRUM_HIT_H
#define VDRUM_HIT_H

#include <stdint.h>

#include "protocol.h"

/* Called from the IMU thread when a hit fires: velocity 1..127, flags HIT_FLAG_*. */
typedef void (*hit_cb)(uint32_t t_us, uint8_t velocity, uint8_t flags);

void hit_init(hit_cb on_hit);

/* IMU thread context. Samples are consecutive at the IMU rate, the first one at first_time_us. */
void hit_process(const struct imu_sample *samples, uint32_t count, uint32_t first_time_us);

#endif /* VDRUM_HIT_H */
```

## src/imu.c
```c
/*
 * LSM6DS3TR-C FIFO streaming, through ST's driver shipped with NCS v3.4.1
 * (modules/hal/st/sensor/stmemsc/lsm6ds3tr-c_STdC).
 *
 * Hardware (zephyr/boards/seeed/xiao_ble/xiao_ble_nrf52840_sense.dts, NCS v3.4.1): sensor on
 * i2c0 at 0x6A, INT1 on P0.11 (irq-gpios), power switched by P1.08 through the
 * "lsm6ds3tr-c-en" fixed regulator, which is on at boot (CONFIG_REGULATOR).
 *
 * FIFO: gyroscope and accelerometer batched at the same rate, so each sample is a pattern of
 * 6 words (two data sets of X, Y, Z): gyroscope as data set 1, accelerometer as data set 2 (ST's
 * order, LSM6DS3 datasheet, FIFO section), checked on both sticks on 2026-11-09 (gravity on the
 * second triplet at rest). The order is fixed: firmware 8 and earlier voted on the first 64
 * samples whatever the motion, and the left stick, flashed while being shaken, took its
 * accelerometer for its gyroscope (spinning while lying, never calibrated, never asleep). Any
 * vote can still go wrong and could not be undone without a reset.
 *
 * TO VERIFY ON HARDWARE: multi-byte reads of FIFO_DATA_OUT rely on the output address rolling
 * back from FIFO_DATA_OUT_H to FIFO_DATA_OUT_L, as in ST's FIFO examples (compare one burst read
 * with word-by-word reads at bring-up).
 *
 * INT1 (FIFO threshold, FTH) follows the FIFO_STATUS2 "waterm" flag, high while the FIFO holds
 * at least the threshold. It is armed on its rising edge, so every drain reads until the level is
 * back below the threshold: otherwise INT1 would stay high, no new edge would come, and only the
 * 20 ms timeout would read the FIFO (expert review, 2026-10-29).
 *
 * Sleep: imu_prepare_sleep() reconfigures the sensor from the IMU thread, which owns the bus.
 * The wake-up event compares the accelerometer slope with WAKE_UP_THS (1 LSB = FS_XL / 64,
 * WAKE_UP_DUR 1 LSB = 1 / ODR: lsm6ds3tr-c_reg.c); routing it to INT1 also sets
 * INTERRUPTS_ENABLE (lsm6ds3tr_c_pin_int1_route_set). The nRF52840 GPIO keeps its configuration
 * through System OFF, so the sensor stays powered (P1.08) and INT1 keeps its sense level.
 *
 * Timestamps: the INT1 edge marks the arrival of the FIFO_THRESHOLD_SAMPLES-th unread sample. The
 * ISR records that time; sample times follow a continuous count at the nominal period, pulled
 * slowly towards each edge (drift of the IMU clock), and snapped to it after a disruption.
 */

#include "imu.h"

#include <errno.h>
#include <stdbool.h>
#include <stdlib.h>
#include <string.h>

#include <zephyr/irq.h>

#include <zephyr/drivers/gpio.h>
#include <zephyr/drivers/i2c.h>
#include <zephyr/kernel.h>

#include "lsm6ds3tr-c_reg.h"

#define IMU_NODE DT_NODELABEL(lsm6ds3tr_c)

#define WORDS_PER_SAMPLE 6u
#define FIFO_THRESHOLD_SAMPLES RAW_MAX_SAMPLES /* one RAW packet per interrupt */
#define READ_SAMPLES_PER_TRANSFER 8u          /* 96 bytes per I2C read */
#define MAX_DRAIN_ROUNDS 8u                   /* bounded: the FIFO refills while it is read */
#define MAX_WRITE_LEN 8u                      /* longest register write made here: 1 byte */

/* The IMU supply (lsm6ds3tr-c-en) is switched on at boot, but regulator_fixed_init skips its
 * 3 ms startup-delay-us when the regulator is enabled at boot (regulator_common_init with
 * is_enabled set, NCS v3.4.1): the first I2C read can come before the IMU is up, and it then
 * times out (measured on the board: -ETIMEDOUT on WHO_AM_I, fine one second later).
 */
#define BOOT_WAIT_MS 10
#define BOOT_ATTEMPTS 10

/* Timestamp tracking: snap when the edge disagrees by more than this, else move 1/8 of the way. */
#define SNAP_THRESHOLD_US (2u * IMU_SAMPLE_PERIOD_US)
#define DRIFT_GAIN_SHIFT 3

/* lsm6ds3tr_c_fifo_raw_data_get takes a uint8_t length. */
BUILD_ASSERT(READ_SAMPLES_PER_TRANSFER * WORDS_PER_SAMPLE * sizeof(int16_t) <= UINT8_MAX,
	     "FIFO read too long for one transfer");
BUILD_ASSERT(FIFO_THRESHOLD_SAMPLES >= 1u, "FIFO threshold must be at least one sample");

/* Wake-up on a sharp knock only (user request, 2026-11-06): +-4 g full scale, threshold
 * 24 x 4 g / 64 = 1.5 g of slope, no minimum duration, at 104 Hz so that a short knock is not
 * missed between samples. Set by trying (2026-11-09): at 1 g a rather soft knock woke the
 * sticks, 2.5 g needed too hard a knock.
 * Not measured: the sleep current at 104 Hz (higher than at 26 Hz).
 */
#define WAKEUP_THRESHOLD 24u
#define WAKEUP_SETTLE_MS 100 /* ~10 samples at 104 Hz: the slope filter starts from 0 */
#define WAKEUP_ARM_TIMEOUT_MS 500

static const struct i2c_dt_spec bus = I2C_DT_SPEC_GET(IMU_NODE);
static const struct gpio_dt_spec int1 = GPIO_DT_SPEC_GET(IMU_NODE, irq_gpios);

static struct gpio_callback int1_callback;
static K_SEM_DEFINE(fifo_ready, 0, 1);
static imu_batch_cb batch_callback;
static struct imu_stats stats;
static stmdev_ctx_t ctx;

static atomic_t sleep_requested;
static K_SEM_DEFINE(wakeup_armed, 0, 1);
static int wakeup_result;

/* Time of the last INT1 edge, and whether a drain has not used it yet (ISR writes, the IMU
 * thread reads both under irq_lock so that they always belong together).
 */
static volatile uint32_t edge_time_us;
static volatile bool edge_pending;

/* End of the last FIFO read. An edge older than this was produced by samples that have been
 * read since: the FIFO head has moved and that edge no longer locates it.
 */
static uint32_t last_read_end_us;

/* Expected time of the oldest unread sample in the FIFO; valid once timing_known is set. */
static uint32_t head_time_us;
static bool timing_known;

static int32_t bus_write(void *handle, uint8_t reg, const uint8_t *data, uint16_t len)
{
	/* One message (register address, then data): i2c_burst_write_dt sends two messages, which
	 * the nRF TWIM driver must join in its concatenation buffer, and the xiao_ble devicetree
	 * gives i2c0 none (no zephyr,concat-buf-size): such writes fail with -ENOSPC
	 * (zephyr/drivers/i2c/i2c_nrfx_twim.c, NCS v3.4.1).
	 */
	uint8_t buffer[1u + MAX_WRITE_LEN];

	ARG_UNUSED(handle);
	if (len > MAX_WRITE_LEN) {
		return -EINVAL;
	}
	buffer[0] = reg;
	memcpy(&buffer[1], data, len);
	return i2c_write_dt(&bus, buffer, 1u + len);
}

static int32_t bus_read(void *handle, uint8_t reg, uint8_t *data, uint16_t len)
{
	ARG_UNUSED(handle);
	return i2c_burst_read_dt(&bus, reg, data, len);
}

static void bus_delay(uint32_t ms)
{
	k_msleep(ms);
}

static void int1_isr(const struct device *port, struct gpio_callback *cb, uint32_t pins)
{
	ARG_UNUSED(port);
	ARG_UNUSED(cb);
	ARG_UNUSED(pins);
	edge_time_us = (uint32_t)k_ticks_to_us_floor64(k_uptime_ticks());
	edge_pending = true;
	k_sem_give(&fifo_ready);
}

static int configure(void)
{
	uint8_t id = 0;
	uint8_t resetting = 1;
	int32_t err = 0;

	ctx.write_reg = bus_write;
	ctx.read_reg = bus_read;
	ctx.mdelay = bus_delay;
	ctx.handle = NULL;

	/* Wait for the IMU to answer (see BOOT_WAIT_MS). */
	int32_t read_err = -EIO;

	for (int i = 0; i < BOOT_ATTEMPTS && read_err != 0; i++) {
		k_msleep(BOOT_WAIT_MS);
		read_err = lsm6ds3tr_c_device_id_get(&ctx, &id);
	}
	if (read_err != 0) {
		return -EIO;
	}
	if (id != LSM6DS3TR_C_ID) {
		return -ENODEV;
	}

	err |= lsm6ds3tr_c_reset_set(&ctx, PROPERTY_ENABLE);
	for (int i = 0; i < 100 && resetting; i++) {
		err |= lsm6ds3tr_c_reset_get(&ctx, &resetting);
		k_msleep(1);
	}

	err |= lsm6ds3tr_c_auto_increment_set(&ctx, PROPERTY_ENABLE);
	err |= lsm6ds3tr_c_block_data_update_set(&ctx, PROPERTY_ENABLE);
	err |= lsm6ds3tr_c_xl_full_scale_set(&ctx, LSM6DS3TR_C_16g);
	err |= lsm6ds3tr_c_gy_full_scale_set(&ctx, LSM6DS3TR_C_2000dps);

	/* FIFO: both sensors, no decimation, continuous (stream) mode, threshold in words. */
	err |= lsm6ds3tr_c_fifo_mode_set(&ctx, LSM6DS3TR_C_BYPASS_MODE); /* clears the FIFO */
	err |= lsm6ds3tr_c_fifo_watermark_set(&ctx, (uint16_t)(FIFO_THRESHOLD_SAMPLES * WORDS_PER_SAMPLE));
	err |= lsm6ds3tr_c_fifo_xl_batch_set(&ctx, LSM6DS3TR_C_FIFO_XL_NO_DEC);
	err |= lsm6ds3tr_c_fifo_gy_batch_set(&ctx, LSM6DS3TR_C_FIFO_GY_NO_DEC);
	err |= lsm6ds3tr_c_fifo_data_rate_set(&ctx, LSM6DS3TR_C_FIFO_1k66Hz);
	err |= lsm6ds3tr_c_fifo_mode_set(&ctx, LSM6DS3TR_C_STREAM_MODE);

	/* INT1 pulses on the FIFO threshold. */
	lsm6ds3tr_c_int1_route_t route = { 0 };

	route.int1_fth = PROPERTY_ENABLE;
	err |= lsm6ds3tr_c_pin_int1_route_set(&ctx, route);

	return err == 0 ? 0 : -EIO;
}

/* Started last, after INT1 is armed, so that the first threshold edge cannot be missed. */
static int start_sensors(void)
{
	int32_t err = 0;

	err |= lsm6ds3tr_c_xl_data_rate_set(&ctx, LSM6DS3TR_C_XL_ODR_1k66Hz);
	err |= lsm6ds3tr_c_gy_data_rate_set(&ctx, LSM6DS3TR_C_GY_ODR_1k66Hz);
	return err == 0 ? 0 : -EIO;
}

struct fifo_status {
	uint16_t level;   /* unread words */
	uint16_t pattern; /* index of the next word in the 6-word sample pattern */
	bool overrun;
};

/*
 * FIFO_STATUS1..4 (0x3A-0x3D) in one burst instead of five single-byte reads. Layout from
 * lsm6ds3tr-c_reg.h (NCS v3.4.1): level = STATUS2[2:0] << 8 | STATUS1, overrun = STATUS2 bit 6,
 * pattern = STATUS4[1:0] << 8 | STATUS3. Register auto-increment (IF_INC) is set in configure().
 */
/* Microseconds since boot. Not k_cycle_get_64(): without CONFIG_TIMER_HAS_64BIT_CYCLE_COUNTER
 * (nRF52 RTC timer) it returns 0. Kernel ticks are 64-bit, 32768 per second (~30.5 us).
 */
static uint32_t now_us(void)
{
	return (uint32_t)k_ticks_to_us_floor64(k_uptime_ticks());
}

static int read_fifo_status(struct fifo_status *out)
{
	uint8_t reg[4];

	if (lsm6ds3tr_c_read_reg(&ctx, LSM6DS3TR_C_FIFO_STATUS1, reg, sizeof(reg)) != 0) {
		stats.bus_errors++;
		return -EIO;
	}
	out->level = (uint16_t)(((reg[1] & 0x07u) << 8) | reg[0]);
	out->overrun = (reg[1] & 0x40u) != 0;
	out->pattern = (uint16_t)(((reg[3] & 0x03u) << 8) | reg[2]);
	return 0;
}

/* Updates head_time_us from a fresh INT1 edge, if any (see the timestamps note at the top). */
static void track_edge(bool disrupted)
{
	const unsigned int key = irq_lock();
	const bool pending = edge_pending;
	const uint32_t edge = edge_time_us;

	edge_pending = false;
	irq_unlock(key);

	if (!pending || (int32_t)(edge - last_read_end_us) < 0) {
		/* No edge, or a stale one (raised during an earlier read of this drain). */
		if (disrupted) {
			timing_known = false; /* samples were lost: wait for a fresh edge */
		}
		return;
	}

	const uint32_t estimate = edge - (FIFO_THRESHOLD_SAMPLES - 1u) * IMU_SAMPLE_PERIOD_US;
	const int32_t error = (int32_t)(estimate - head_time_us);

	if (!timing_known || disrupted || (uint32_t)abs(error) > SNAP_THRESHOLD_US) {
		head_time_us = estimate;
		timing_known = true;
	} else {
		head_time_us += (uint32_t)(error / (1 << DRIFT_GAIN_SHIFT));
	}
}

/* Skips the words of a partly read sample, so that reads start on a sample boundary. */
static int realign(struct fifo_status *status)
{
	while (status->pattern != 0 && status->level > 0) {
		int16_t discard;

		if (lsm6ds3tr_c_fifo_raw_data_get(&ctx, (uint8_t *)&discard, sizeof(discard)) != 0) {
			stats.bus_errors++;
			timing_known = false;
			return -EIO;
		}
		last_read_end_us = now_us();
		status->level--;
		status->pattern = (uint16_t)((status->pattern + 1u) % WORDS_PER_SAMPLE);
	}
	return 0;
}

/* Reads `available` complete samples and hands them over in batches. */
static int read_samples(uint32_t available)
{
	while (available > 0) {
		static int16_t words[READ_SAMPLES_PER_TRANSFER * WORDS_PER_SAMPLE];
		static struct imu_sample samples[READ_SAMPLES_PER_TRANSFER];
		const uint32_t count = MIN(available, READ_SAMPLES_PER_TRANSFER);

		if (lsm6ds3tr_c_fifo_raw_data_get(&ctx, (uint8_t *)words,
						  (uint8_t)(count * WORDS_PER_SAMPLE * sizeof(int16_t))) != 0) {
			stats.bus_errors++;
			timing_known = false; /* unknown how much was consumed: resync on the next edge */
			return -EIO;
		}
		last_read_end_us = now_us();

		for (uint32_t i = 0; i < count; i++) {
			const int16_t *w = &words[i * WORDS_PER_SAMPLE];

			samples[i] = (struct imu_sample){
				.gx = w[0], .gy = w[1], .gz = w[2],
				.ax = w[3], .ay = w[4], .az = w[5],
			};
		}

		stats.samples += count;
		stats.batches++;
		/* Samples read before the first edge have no time base: skipped. */
		if (batch_callback != NULL && timing_known) {
			batch_callback(samples, count, head_time_us);
		}

		head_time_us += count * IMU_SAMPLE_PERIOD_US;
		available -= count;
	}
	return 0;
}

/* Reads until the FIFO is back below the threshold, so that INT1 can rise again. */
static void drain_fifo(void)
{
	for (uint32_t round = 0; round < MAX_DRAIN_ROUNDS; round++) {
		struct fifo_status status;

		if (read_fifo_status(&status) != 0) {
			return;
		}
		if (round == 0 && status.overrun) {
			stats.fifo_overruns++; /* once per drain: the flag stays set over the rounds */
		}
		/* Every round: an edge raised while this drain read the FIFO is fresh only if it came
		 * after the last read (checked in track_edge).
		 */
		track_edge(round == 0 && (status.overrun || status.pattern != 0));
		if (realign(&status) != 0) {
			return;
		}

		const uint32_t available = status.level / WORDS_PER_SAMPLE;

		if (round > 0 && available < FIFO_THRESHOLD_SAMPLES) {
			return; /* below the threshold: INT1 is low, the next edge will come */
		}
		if (available == 0 || read_samples(available) != 0) {
			return;
		}
	}
}

/* See the sleep note at the top. */
static int arm_wakeup(void)
{
	int32_t err = 0;
	lsm6ds3tr_c_int1_route_t route = { 0 };

	if (gpio_pin_interrupt_configure_dt(&int1, GPIO_INT_DISABLE) != 0) {
		return -EIO;
	}
	err |= lsm6ds3tr_c_gy_data_rate_set(&ctx, LSM6DS3TR_C_GY_ODR_OFF);
	err |= lsm6ds3tr_c_xl_data_rate_set(&ctx, LSM6DS3TR_C_XL_ODR_OFF);
	err |= lsm6ds3tr_c_fifo_mode_set(&ctx, LSM6DS3TR_C_BYPASS_MODE);
	err |= lsm6ds3tr_c_xl_full_scale_set(&ctx, LSM6DS3TR_C_4g);
	err |= lsm6ds3tr_c_xl_power_mode_set(&ctx, LSM6DS3TR_C_XL_NORMAL); /* high performance off */
	err |= lsm6ds3tr_c_int_notification_set(&ctx, LSM6DS3TR_C_INT_PULSED);
	err |= lsm6ds3tr_c_wkup_dur_set(&ctx, 0);
	err |= lsm6ds3tr_c_wkup_threshold_set(&ctx, WAKEUP_THRESHOLD);
	route.int1_wu = PROPERTY_ENABLE; /* and nothing else: the FIFO threshold is off */
	err |= lsm6ds3tr_c_pin_int1_route_set(&ctx, route);
	err |= lsm6ds3tr_c_xl_data_rate_set(&ctx, LSM6DS3TR_C_XL_ODR_104Hz);
	if (err != 0) {
		return -EIO;
	}
	k_msleep(WAKEUP_SETTLE_MS);

	/* Level sense: the DETECT signal that wakes the chip from System OFF (Zephyr sample
	 * samples/boards/nordic/system_off). INT1 still high here wakes it right away: a reboot.
	 */
	return gpio_pin_interrupt_configure_dt(&int1, GPIO_INT_LEVEL_ACTIVE);
}

static void imu_thread(void *a, void *b, void *c)
{
	ARG_UNUSED(a);
	ARG_UNUSED(b);
	ARG_UNUSED(c);

	while (1) {
		/* The timeout catches a missed edge: the FIFO is drained in any case. */
		(void)k_sem_take(&fifo_ready, K_MSEC(20));
		if (atomic_get(&sleep_requested)) {
			wakeup_result = arm_wakeup();
			k_sem_give(&wakeup_armed);
			return;
		}
		drain_fifo();
	}
}

K_THREAD_STACK_DEFINE(imu_stack, 2048);
static struct k_thread imu_thread_data;

int imu_start(imu_batch_cb callback)
{
	int err;

	if (!i2c_is_ready_dt(&bus) || !gpio_is_ready_dt(&int1)) {
		return -ENODEV;
	}

	batch_callback = callback;
	err = configure();
	if (err) {
		return err;
	}

	err = gpio_pin_configure_dt(&int1, GPIO_INPUT);
	err = err ? err : gpio_pin_interrupt_configure_dt(&int1, GPIO_INT_EDGE_TO_ACTIVE);
	if (err) {
		return err;
	}
	gpio_init_callback(&int1_callback, int1_isr, BIT(int1.pin));
	err = gpio_add_callback(int1.port, &int1_callback);
	err = err ? err : start_sensors();
	if (err) {
		return err;
	}

	/* Cooperative priority: the hit detection that will run here is latency critical. */
	k_thread_create(&imu_thread_data, imu_stack, K_THREAD_STACK_SIZEOF(imu_stack), imu_thread,
			NULL, NULL, NULL, K_PRIO_COOP(2), 0, K_NO_WAIT);
	k_thread_name_set(&imu_thread_data, "imu");
	return 0;
}

void imu_get_stats(struct imu_stats *out)
{
	*out = stats;
}

int imu_prepare_sleep(void)
{
	atomic_set(&sleep_requested, 1);
	k_sem_give(&fifo_ready);
	if (k_sem_take(&wakeup_armed, K_MSEC(WAKEUP_ARM_TIMEOUT_MS)) != 0) {
		return -ETIMEDOUT;
	}
	return wakeup_result;
}
```

## src/imu.h
```c
/*
 * LSM6DS3TR-C streaming through its FIFO: accelerometer +-16 g and gyroscope +-2000 dps,
 * both at 1.66 kHz, read in batches on the FIFO threshold interrupt (INT1).
 */
#ifndef VDRUM_IMU_H
#define VDRUM_IMU_H

#include <stdint.h>

#include "protocol.h"

#define IMU_ODR_HZ 1666u
#define IMU_SAMPLE_PERIOD_US 600u /* 1e6 / 1666, rounded */

/* Called from the IMU thread for each batch of consecutive samples (oldest first). */
typedef void (*imu_batch_cb)(const struct imu_sample *samples, uint32_t count, uint32_t first_sample_time_us);

/* Configures the sensor and starts streaming. Returns 0 or a negative errno. */
int imu_start(imu_batch_cb callback);

struct imu_stats {
	uint32_t samples;
	uint32_t batches;
	uint32_t fifo_overruns; /* FIFO filled up before it was read: samples were lost */
	uint32_t bus_errors;
};

void imu_get_stats(struct imu_stats *stats);

/* Stops streaming and leaves the sensor watching for motion: accelerometer alone at 104 Hz,
 * INT1 pulsing on a sharp knock (1.5 g of slope), and INT1 set to wake the nRF52840 from System OFF (level
 * sense). The IMU thread ends. Returns 0, or a negative errno with streaming stopped anyway.
 */
int imu_prepare_sleep(void);

#endif /* VDRUM_IMU_H */
```

## src/radio.c
```c
/*
 * ESB transmitter of a stick. Setup follows nrf/samples/esb/esb_ptx (NCS v3.4.1).
 *
 * After a failed transmission (no ACK once retransmits are exhausted) ESB suspends TX with the
 * failed payload still at the head of its FIFO (nrf/subsys/esb/esb.c, on_radio_disabled_tx_wait
 * _for_ack): the payload is dropped (the receiver sees a gap in seq) and TX restarted, so that a
 * lost packet never stalls the stream.
 *
 * The receiver can send a command back in an ACK payload (pkt_cmd, docs/PROTOCOL.md):
 * CMD_ENTER_BOOTLOADER restarts the stick into its UF2 bootloader, so that it is flashed
 * without the double tap on the reset button.
 */

#include "radio.h"

#include <errno.h>
#include <stddef.h>
#include <string.h>

#include <esb.h>
#include <hal/nrf_power.h>
#include <zephyr/kernel.h>
#include <zephyr/sys/atomic.h>
#include <zephyr/sys/byteorder.h>
#include <zephyr/sys/reboot.h>

#include "imu.h"
#include "radio_config.h"

BUILD_ASSERT(CONFIG_ESB_MAX_PAYLOAD_LENGTH >= VDRUM_ESB_MIN_PAYLOAD_CAPACITY,
	     "CONFIG_ESB_MAX_PAYLOAD_LENGTH too small for RAW packets");
BUILD_ASSERT(VDRUM_ESB_RETRANSMIT_DELAY_US(0) >= VDRUM_ESB_RETRANSMIT_DELAY_MIN_US &&
		     VDRUM_ESB_RETRANSMIT_DELAY_US(1) >= VDRUM_ESB_RETRANSMIT_DELAY_MIN_US,
	     "esb_init rejects retransmit delays below 435 us");

#define FIRMWARE_VERSION 10

/*
 * GPREGRET value that makes the Adafruit nRF52 bootloader (the XIAO's UF2 bootloader) start in
 * UF2 mode after a reset: DFU_MAGIC_UF2_RESET in src/main.c of
 * github.com/adafruit/Adafruit_nRF52_Bootloader (check_dfu_mode reads NRF_POWER->GPREGRET).
 */
#define BOOTLOADER_UF2_MAGIC 0x57

static uint8_t stick;
static uint16_t next_seq;
static struct k_spinlock seq_lock;

static atomic_t queued, sent, failed, full, retries;

/* RAW packets come from the IMU thread, STATUS from the main thread: one writer at a time. */
static K_MUTEX_DEFINE(write_lock);

/* RAW packet being filled by the IMU thread. */
static struct pkt_raw raw;
static uint32_t raw_first_time;

/* Runs in the radio interrupt. */
static void handle_ack_payloads(void)
{
	struct esb_payload payload;

	while (esb_read_rx_payload(&payload) == 0) {
		if (payload.length != sizeof(struct pkt_cmd) || payload.data[0] != PKT_CMD ||
		    payload.data[1] != stick) {
			continue;
		}
		const uint8_t cmd = payload.data[offsetof(struct pkt_cmd, cmd)];
		const uint32_t magic = sys_get_le32(&payload.data[offsetof(struct pkt_cmd, magic)]);

		if (magic != CMD_MAGIC || k_uptime_get() < CMD_IGNORE_AFTER_BOOT_MS) {
			continue;
		}
		if (cmd == CMD_ENTER_BOOTLOADER) {
			nrf_power_gpregret_set(NRF_POWER, 0, BOOTLOADER_UF2_MAGIC);
			sys_reboot(SYS_REBOOT_COLD);
		}
	}
}

static void esb_event(struct esb_evt const *event)
{
	switch (event->evt_id) {
	case ESB_EVENT_RX_RECEIVED:
		handle_ack_payloads();
		break;
	/* One event may stand for several packets (esb_evt_irq_handler merges interrupt flags):
	 * sent and retries are approximate, failed is exact enough for loss statistics.
	 */
	case ESB_EVENT_TX_SUCCESS:
		atomic_inc(&sent);
		atomic_add(&retries, (atomic_val_t)(event->tx_attempts > 0 ? event->tx_attempts - 1 : 0));
		break;
	case ESB_EVENT_TX_FAILED:
		atomic_inc(&failed);
		atomic_add(&retries, (atomic_val_t)(event->tx_attempts > 0 ? event->tx_attempts - 1 : 0));
		(void)esb_pop_tx();
		(void)esb_start_tx(); /* -ENODATA when nothing else is queued */
		break;
	default:
		break;
	}
}

static uint16_t take_seq(void)
{
	k_spinlock_key_t key = k_spin_lock(&seq_lock);
	const uint16_t seq = next_seq++;

	k_spin_unlock(&seq_lock, key);
	return seq;
}

static void send_payload(const void *data, uint8_t length)
{
	struct esb_payload payload = {
		.length = length,
		.pipe = VDRUM_ESB_PIPE_FOR_STICK(stick),
		.noack = false,
	};

	memcpy(payload.data, data, length);

	(void)k_mutex_lock(&write_lock, K_FOREVER);
	const int err = esb_write_payload(&payload);

	k_mutex_unlock(&write_lock);

	if (err == 0) {
		atomic_inc(&queued);
	} else {
		atomic_inc(&full);
	}
}

int radio_start(uint8_t stick_id)
{
	uint8_t base_addr_0[4] = VDRUM_ESB_BASE_ADDR_0;
	uint8_t base_addr_1[4] = VDRUM_ESB_BASE_ADDR_1;
	uint8_t prefixes[VDRUM_ESB_PIPE_COUNT] = VDRUM_ESB_PREFIXES;
	struct esb_config config = ESB_DEFAULT_CONFIG;
	int err;

	stick = stick_id;

	config.protocol = ESB_PROTOCOL_ESB_DPL;
	config.bitrate = ESB_BITRATE_2MBPS;
	config.mode = ESB_MODE_PTX;
	config.event_handler = esb_event;
	config.selective_auto_ack = true;
	config.retransmit_delay = VDRUM_ESB_RETRANSMIT_DELAY_US(stick_id);
	config.retransmit_count = VDRUM_ESB_RETRANSMIT_COUNT;
	config.tx_mode = ESB_TXMODE_AUTO;
	config.use_fast_ramp_up = VDRUM_ESB_FAST_RAMP_UP;
	config.tx_output_power = VDRUM_ESB_TX_POWER_DBM;

	err = esb_init(&config);
	err = err ? err : esb_set_rf_channel(VDRUM_ESB_RF_CHANNEL);
	err = err ? err : esb_set_base_address_0(base_addr_0);
	err = err ? err : esb_set_base_address_1(base_addr_1);
	err = err ? err : esb_set_prefixes(prefixes, ARRAY_SIZE(prefixes));
	return err;
}

static void send_raw(void)
{
	raw.hdr.type = PKT_RAW;
	raw.hdr.stick_id = stick;
	raw.hdr.seq = take_seq();
	raw.t0_us = raw_first_time;
	send_payload(&raw, PKT_RAW_SIZE(raw.n));
	raw.n = 0;
}

void radio_send_samples(const struct imu_sample *samples, uint32_t count, uint32_t first_time_us)
{
	/* A RAW packet holds consecutive samples at t0 + i / ODR. If this batch does not continue
	 * the partial packet (time base resynchronised, samples skipped), send the partial packet
	 * first: the protocol allows packets of fewer than RAW_MAX_SAMPLES samples. Half a period
	 * of tolerance lets the small drift corrections through.
	 */
	if (raw.n > 0) {
		const uint32_t expected = raw_first_time + raw.n * IMU_SAMPLE_PERIOD_US;
		const int32_t error = (int32_t)(first_time_us - expected);

		if (error > (int32_t)(IMU_SAMPLE_PERIOD_US / 2) || error < -(int32_t)(IMU_SAMPLE_PERIOD_US / 2)) {
			send_raw();
		}
	}

	for (uint32_t i = 0; i < count; i++) {
		if (raw.n == 0) {
			raw_first_time = first_time_us + i * IMU_SAMPLE_PERIOD_US;
		}
		raw.samples[raw.n++] = samples[i];

		if (raw.n == RAW_MAX_SAMPLES) {
			send_raw();
		}
	}
}

void radio_send_hit(uint32_t t_us, uint8_t velocity, const int16_t quat[4], uint8_t flags)
{
	struct pkt_hit hit = {
		.hdr = { .type = PKT_HIT, .stick_id = stick, .seq = take_seq() },
		.t_us = t_us,
		.velocity = velocity,
		.quat = { quat[0], quat[1], quat[2], quat[3] },
		.flags = flags,
	};

	send_payload(&hit, sizeof(hit));
}

void radio_send_orient(uint32_t t_us, const int16_t quat[4])
{
	struct pkt_orient orient = {
		.hdr = { .type = PKT_ORIENT, .stick_id = stick, .seq = take_seq() },
		.t_us = t_us,
		.quat = { quat[0], quat[1], quat[2], quat[3] },
	};

	send_payload(&orient, sizeof(orient));
}

void radio_send_status(uint16_t vbat_mv, uint32_t imu_overruns, const int16_t gyro_bias[3])
{
	struct pkt_status status = {
		.hdr = { .type = PKT_STATUS, .stick_id = stick, .seq = take_seq() },
		.vbat_mv = vbat_mv,
		.gyro_bias = { gyro_bias[0], gyro_bias[1], gyro_bias[2] },
		.fw_version = FIRMWARE_VERSION,
		.tx_retries = (uint16_t)atomic_get(&retries),
		.tx_failed = (uint16_t)atomic_get(&failed),
		.tx_queue_full = (uint16_t)atomic_get(&full),
		.imu_overruns = (uint16_t)imu_overruns,
	};

	send_payload(&status, sizeof(status));
}

void radio_get_stats(struct radio_stats *stats)
{
	stats->packets_queued = (uint32_t)atomic_get(&queued);
	stats->packets_sent = (uint32_t)atomic_get(&sent);
	stats->packets_failed = (uint32_t)atomic_get(&failed);
	stats->queue_full = (uint32_t)atomic_get(&full);
	stats->retries = (uint32_t)atomic_get(&retries);
}
```

## src/radio.h
```c
/*
 * ESB transmitter (PTX) of a stick: packs IMU samples into RAW packets of up to RAW_MAX_SAMPLES
 * samples and sends them, plus a STATUS packet once per second (docs/PROTOCOL.md).
 */
#ifndef VDRUM_RADIO_H
#define VDRUM_RADIO_H

#include <stdint.h>

#include "protocol.h"

int radio_start(uint8_t stick_id);

/* IMU thread context. Samples are consecutive at the IMU rate, the first one at first_time_us. */
void radio_send_samples(const struct imu_sample *samples, uint32_t count, uint32_t first_time_us);

/* Sends a HIT packet (IMU thread context). quat: w, x, y, z in Q14, stick -> world. */
void radio_send_hit(uint32_t t_us, uint8_t velocity, const int16_t quat[4], uint8_t flags);

/* Sends an ORIENT packet (IMU thread context). */
void radio_send_orient(uint32_t t_us, const int16_t quat[4]);

/* Sends a STATUS packet (thread context). */
/* imu_overruns: IMU FIFO overrun count, reported in STATUS (protocol v4). gyro_bias in raw
 * gyro counts. */
void radio_send_status(uint16_t vbat_mv, uint32_t imu_overruns, const int16_t gyro_bias[3]);

struct radio_stats {
	uint32_t packets_queued;
	uint32_t packets_sent;
	uint32_t packets_failed;  /* no ACK after all retransmits: lost */
	uint32_t queue_full;      /* not queued: the radio could not keep up */
	uint32_t retries;         /* extra attempts (approximate, see radio.c) */
};

void radio_get_stats(struct radio_stats *stats);

#endif /* VDRUM_RADIO_H */
```
